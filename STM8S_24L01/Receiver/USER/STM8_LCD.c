/* Includes ------------------------------------------------------------------*/
//#include "stm8s.h"
#include "STM8_LCD.h"
#include "stm8s.h"
//6x8.h文件：
/*-----------------------------------------------
6 x 8 font
1 pixel space at left and bottom
index = ASCII - 32
-----------------------------------------------*/
const unsigned char  font6x8[][6] =
{
{ 0x00, 0x00, 0x00, 0x00, 0x00, 0x00 },// sp
{ 0x00, 0x00, 0x00, 0x2f, 0x00, 0x00 },// !
{ 0x00, 0x00, 0x07, 0x00, 0x07, 0x00 },// "
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{ 0x14, 0x14, 0x14, 0x14, 0x14, 0x14 }// horiz lines
}; 



const unsigned char hanzi[]=
{
	/*--  文字:  室  --*/
	/*--  Trebuchet MS9;  此字体下对应的点阵为：宽x高=12x12   --*/
	/*--  高度不是8的倍数，现调整为：宽度x高度=12x16  --*/
	0x1C,0x04,0x94,0xD4,0xB5,0x96,0x94,0xD4,0x94,0x04,0x1C,0x00,0x08,0x0A,0x0A,0x0A,
	0x0A,0x0F,0x0A,0x0A,0x0A,0x0A,0x08,0x00,
	
	/*--  文字:  内  --*/
	/*--  Trebuchet MS9;  此字体下对应的点阵为：宽x高=12x12   --*/
	/*--  高度不是8的倍数，现调整为：宽度x高度=12x16  --*/
	0x00,0xFC,0x04,0x84,0x64,0x1F,0x24,0xC4,0x04,0xFC,0x00,0x00,0x00,0x0F,0x00,0x00,
	0x00,0x00,0x00,0x08,0x08,0x0F,0x00,0x00,
	
	/*--  文字:  温  --*/
	/*--  Trebuchet MS9;  此字体下对应的点阵为：宽x高=12x12   --*/
	/*--  高度不是8的倍数，现调整为：宽度x高度=12x16  --*/
	0x22,0x44,0x00,0xC0,0x5F,0xD5,0x55,0xD5,0x5F,0xC0,0x00,0x00,0x04,0x02,0x09,0x0F,
	0x08,0x0F,0x08,0x0F,0x08,0x0F,0x08,0x00,
	
	/*--  文字:  度  --*/
	/*--  Trebuchet MS9;  此字体下对应的点阵为：宽x高=12x12   --*/
	/*--  高度不是8的倍数，现调整为：宽度x高度=12x16  --*/
	0x00,0xFE,0x0A,0x8A,0xBE,0xAA,0xAB,0xAA,0xBE,0x8A,0x0A,0x00,0x08,0x07,0x00,0x08,
	0x09,0x0A,0x04,0x04,0x0A,0x09,0x08,0x00,
	
	/*--  文字:  :	--*/
	/*--  Trebuchet MS9;  此字体下对应的点阵为：宽x高=12x12   --*/
	/*--  高度不是8的倍数，现调整为：宽度x高度=12x16  --*/
	0x00,0x00,0x10,0x00,0x00,0x00,0x00,0x00,0x00,0x00,0x00,0x00,0x00,0x00,0x02,0x00,
	0x00,0x00,0x00,0x00,0x00,0x00,0x00,0x00,
	

	/*--  文字:  湿  --*/
	/*--  Trebuchet MS9;  此字体下对应的点阵为：宽x高=12x12   --*/
	/*--  高度不是8的倍数，现调整为：宽度x高度=12x16  --*/
	0x11,0x22,0x80,0x3E,0x2A,0xEA,0x2A,0xEA,0x2A,0x3E,0x80,0x00,0x04,0x02,0x08,0x09,
	0x08,0x0F,0x08,0x0F,0x08,0x09,0x08,0x00,

	/*--  文字:  ℃  --*/
	/*--  Trebuchet MS9;  此字体下对应的点阵为：宽x高=12x12   --*/
	/*--  高度不是8的倍数，现调整为：宽度x高度=12x16  --*/
	0x02,0x05,0x02,0xF8,0x04,0x02,0x02,0x02,0x04,0x0E,0x80,0x00,0x00,0x00,0x00,0x00,
	0x01,0x02,0x02,0x02,0x02,0x01,0x00,0x00,

};


void Delayus(void) 
{  
    asm("nop"); //一个asm("nop")函数经过示波器测试代表100ns 
    asm("nop"); 
    asm("nop"); 
    asm("nop");  
} 

//---- 毫秒级延时程序----------------------- 
void delayms(unsigned int time) 
{ 
    unsigned int i; 
    while(time--)   
    for(i=900;i>0;i--) 
    Delayus();  
} 
/*--------------------------------------------
LCD_write_byte: 使用SPI接口写数据到LCD
输入参数：dt：写入的数据；
command ：写数据/命令选择；
编写日期：20080918 
----------------------------------------------*/
void LCD_write_byte(unsigned char dt, unsigned char command)
{
	unsigned char i; 
	SCE0;	
        if(command)
	    DC1;
	else
	    DC0;	
	for(i=0;i<8;i++)
	{ 
		if(dt&0x80)
			DN1;
		else
			DN0;
		dt=dt<<1;		
		SCLK0; 		
		SCLK1; 
	}	
	DC1;	
	SCE1;	
	DN1;
}
/*---------------------------------------
LCD_init: 3310LCD初始化
编写日期：20080918 
-----------------------------------------  */
void LCD_init(void)
{
	RST0;  	
  	delayms(10);
  	RST1;  
	LCD_write_byte(0x21,0);//初始化Lcd,功能设定使用扩充指令
	LCD_write_byte(0xC6,0);//设定液晶偏置电压
	LCD_write_byte(0x06,0);//温度校正
  	LCD_write_byte(0x13,0);;//1:48
	LCD_write_byte(0x20,0);//使用基本指令
	LCD_write_byte(0x0C,0);//设定显示模式，正常显示
}
/*-------------------------------------------
LCD_set_XY: 设置LCD坐标函数
输入参数：X：0－83  Y：0－5
编写日期：20080918 
---------------------------------------------*/
void LCD_set_XY(unsigned char X, unsigned char Y)
{
	LCD_write_byte(0x40 | Y, 0);// column
	LCD_write_byte(0x80 | X, 0);// row
} 
/*------------------------------------------
LCD_clear: LCD清屏函数
编写日期：20080918 
--------------------------------------------*/
void LCD_clear(void)
{
	unsigned char t;
	unsigned char k;
	LCD_set_XY(0,0);
	for(t=0;t<6;t++)
	{ 
		for(k=0;k<84;k++)
		{ 
			LCD_write_byte(0x00,1);
				
		} 
	}
}
/*---------------------------------------
名称: 显示英文字符
参数：c：显示的字符在font6x8表格中的位置
----------------------------------------- */
void LCD_write_char(unsigned char c)
{
	unsigned char line;
	c-= 32;
	for (line=0; line<6; line++)
	  LCD_write_byte(font6x8[c][line], 1);
}


/*---------------------------------------------
名称: 英文字符串显示函数
参数：*s：英文字符串指针
-----------------------------------------------*/
void LCD_write_String(unsigned char X,unsigned char Y,char *s)
{
	LCD_set_XY(X,Y);
	while (*s) 
	{
		LCD_write_char(*s);
		s++;
	}
} 


/*---------------------------------------------
LCD_write_hanzi: 显示12（宽）*16（高）点阵列汉字等半角类
输入参数：c：显示的字符；
编写日期：20080918 
-----------------------------------------------*/
void LCD_write_hanzi(unsigned char row, unsigned char page,unsigned char c) //row:列 page:页 dd:字符
{
	unsigned char i;  	
	
	LCD_set_XY(row*6, page);// 列，页 
	for(i=0; i<12;i++) 
	{
		LCD_write_byte(hanzi[c*24+i],1); 
	}
	
    LCD_set_XY(row*6, page+1);// 列，页 
	for(i=12; i<24;i++) 
	{
		LCD_write_byte(hanzi[c*24+i],1);
	}	
}

void LCD_GPIO_Configuration(void)
{
    GPIO_Init(GPIOD, (GPIO_Pin_TypeDef)(GPIO_PIN_1 | GPIO_PIN_2 | GPIO_PIN_3), GPIO_MODE_OUT_PP_HIGH_FAST);
    GPIO_Init(GPIOC, (GPIO_Pin_TypeDef)(GPIO_PIN_3 | GPIO_PIN_4 )  , GPIO_MODE_OUT_PP_HIGH_FAST);
}


void LCD_Display_Name(void)
{
    LCD_write_hanzi(0,0,5);  //韭菜门禁系统	
    LCD_write_hanzi(2,0,6);  //	
    LCD_write_hanzi(4,0,7);  //	
    LCD_write_hanzi(6,0,8);  //	
    LCD_write_hanzi(8,0,9);  //	
    LCD_write_hanzi(10,0,10);  //	
}





